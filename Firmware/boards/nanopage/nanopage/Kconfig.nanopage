## Firmware/boards/nanopage/nanopage/Kconfig.nanopage
```kconfig
# NanoPage board configuration
# SPDX-License-Identifier: Apache-2.0

config BOARD_NANOPAGE
	select SOC_NRF52840_QIAA
```

## Firmware/boards/nanopage/nanopage/board.yml
```yaml
board:
  name: nanopage
  full_name: NanoPage E-Reader
  vendor: nanopage
  socs:
  - name: nrf52840
```
